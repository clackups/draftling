## main/Kconfig.projbuild
```kconfig
menu "DRAFTLING Configuration"

choice DRAFTLING_HARDWARE_MODEL
    prompt "Hardware Model"
    default DRAFTLING_MODEL_LILYGO_T5_EPD_S3_PRO
    help
        Select the target hardware platform for Draftling.

config DRAFTLING_MODEL_WAVESHARE_RLCD42
    bool "Waveshare ESP32-S3-RLCD-4.2"
    depends on IDF_TARGET_ESP32S3
    help
        Waveshare ESP32-S3-RLCD-4.2 board with 400x300 reflective LCD
        and GPIO18 deep-sleep wakeup button.

config DRAFTLING_MODEL_LILYGO_T5_EPD_S3_PRO
    bool "LilyGO T5 E-Paper S3 Pro / Pro Lite"
    depends on IDF_TARGET_ESP32S3
    help
        LilyGO T5 E-Paper S3 Pro (H752-01) board with a 4.7" 540x960
        ED047TC1 e-paper panel driven by the ESP32-S3 LCD/I80 parallel
        peripheral via the vroland/epdiy library (epd_board_v7
        configuration, TPS65185 + PCA9535 power management). Has a
        GT911 capacitive touch controller, BQ27220 fuel gauge,
        PCF8563 RTC, on-board MicroSD slot (SPI shared with the SX1262
        LoRa radio when present), and a BOOT button on GPIO 0 as the
        deep-sleep wake source.

        Also covers the "Pro Lite" SKU, which is the same H752-01
        board with the SX1262 LoRa radio and the MIA-M10Q GPS
        receiver depopulated. Draftling does not touch either part,
        so a single firmware image runs on both variants.

config DRAFTLING_MODEL_LILYGO_T5_EPD_S3_PRO_H752
    bool "LilyGO T5 E-Paper S3 Pro original H752"
    depends on IDF_TARGET_ESP32S3
    help
        Original LilyGO T5 E-Paper S3 Pro H752 / v1.0-240810 board
        with the 4.7" 960x540 ED047TC1 panel. This older revision is
        not pin-compatible with the H752-01 board: it uses SDA=6,
        SCL=5, SD SPI on 18/8/17 with CS=16, GT911 INT=15/RST=41,
        GPIO48 as the user key, GPIO40 as the front-light enable, and
        the older LilyGO EPD47 shift-register display driver path
        instead of epdiy's epd_board_v7 PCA9535/TPS65185 path.

config DRAFTLING_MODEL_M5STACK_PAPERS3
    bool "M5Stack PaperS3"
    depends on IDF_TARGET_ESP32S3
    help
        M5Stack PaperS3 board with a 540x960 e-paper panel (ED047TC1
        family) driven by the ESP32-S3 LCD/I80 parallel peripheral.
        v1 uses a 1-bit black/white waveform with full-screen refresh
        only; partial refresh and grayscale are TODO.

config DRAFTLING_MODEL_WAVESHARE_TOUCH_LCD_349
    bool "Waveshare ESP32-S3-Touch-LCD-3.49 (AXS15231B, 3.49\" color LCD, 640x172)"
    depends on IDF_TARGET_ESP32S3
    help
        Waveshare ESP32-S3-Touch-LCD-3.49 development board: 3.49"
        IPS color LCD, 640x172, AXS15231B controller over QSPI.
        Touch input is not used (Draftling is keyboard-driven).

config DRAFTLING_MODEL_M5STACK_TAB5
    bool "M5Stack Tab5 (ESP32-P4, ILI9881C, 5\" color MIPI-DSI LCD, 1280x720)"
    depends on IDF_TARGET_ESP32P4
    help
        M5Stack Tab5 tablet (ESP32-P4): 5" IPS color LCD, 1280x720,
        ILI9881C controller over MIPI-DSI (2 lanes). On-board GT911
        capacitive touchscreen on I2C. Powered by a 3.7 V Li-ion
        battery with USB-C charging; integrated PMIC, IMU, microphone
        array, speaker, and MicroSD slot. The ESP32-P4 also exposes a
        USB-HS host port and an ESP32-C6 co-processor for Wi-Fi /
        Bluetooth. See https://docs.m5stack.com/en/core/Tab5.

config DRAFTLING_MODEL_JC3248W535
    bool "Guition JC3248W535 (ESP32-S3, AXS15231B, 3.5\" color LCD, 480x320)"
    depends on IDF_TARGET_ESP32S3
    help
        Guition JC3248W535 development board: 3.5" IPS color LCD,
        480x320, AXS15231B controller over QSPI. Has an on-board
        AXS5106L capacitive touchscreen which Draftling uses as a
        secondary input (cursor, scroll, double-tap selection in
        the editor; tap-to-select in menus). This board has no
        user buttons besides the power switch; deep sleep is woken
        by the touchscreen.

config DRAFTLING_MODEL_SUNTON_8048S070
    bool "Sunton ESP32-8048S070C (ESP32-S3, 7\" RGB color LCD, 800x480)"
    depends on IDF_TARGET_ESP32S3
    help
        Sunton ESP32-8048S070C development board: 7" TN color LCD,
        800x480, 16-bit parallel RGB565 interface driven by the
        ESP32-S3 LCD RGB peripheral (esp_lcd_new_rgb_panel). Has an
        on-board GT911 capacitive touchscreen on I2C and a MicroSD
        slot on SPI. Backlight on GPIO2. Keyboard-driven (USB / BLE)
        like every other Draftling board.

config DRAFTLING_MODEL_SUNTON_8048S043
    bool "Sunton ESP32-8048S043C (ESP32-S3, 4.3\" RGB color LCD, 800x480)"
    depends on IDF_TARGET_ESP32S3
    help
        Sunton ESP32-8048S043C development board: 4.3" IPS color LCD,
        800x480, ST7262 panel on a 16-bit parallel RGB565 interface
        driven by the ESP32-S3 LCD RGB peripheral
        (esp_lcd_new_rgb_panel). Shares the 800x480 resolution and the
        same display backend as the 7" ESP32-8048S070C, but uses a
        different control-pin map (VSYNC/DE swapped), different panel
        timings (12.5 MHz, pclk_active_neg), and a different data-line
        order (R,G,B vs the 7" panel's B,G,R). Has an on-board GT911
        capacitive touchscreen on I2C and a MicroSD slot on SPI.
        Backlight on GPIO2. Keyboard-driven (USB / BLE) like every
        other Draftling board.

endchoice

# ---- Derived: display category (driven by hardware-model choice) ----
#
# DRAFTLING_DISPLAY_COLOR is set automatically when the selected board
# has a color (RGB565) panel. Other code (the color-theme selection in
# the editor UI, lvgl_port render mode, etc.) keys off this symbol
# instead of testing every individual board id.
config DRAFTLING_DISPLAY_COLOR
    bool
    default y if DRAFTLING_MODEL_WAVESHARE_TOUCH_LCD_349
    default y if DRAFTLING_MODEL_JC3248W535
    default y if DRAFTLING_MODEL_M5STACK_TAB5
    default y if DRAFTLING_MODEL_SUNTON_8048S070
    default y if DRAFTLING_MODEL_SUNTON_8048S043
    default n

# DRAFTLING_DISPLAY_AXS15231B is set automatically when the selected
# board uses an AXS15231B QSPI controller. The display backend
# (components/display/display_axs15231b.cpp) is compiled in only for
# these boards.
config DRAFTLING_DISPLAY_AXS15231B
    bool
    default y if DRAFTLING_MODEL_WAVESHARE_TOUCH_LCD_349
    default y if DRAFTLING_MODEL_JC3248W535
    default n

# DRAFTLING_DISPLAY_RLCD is set automatically when the selected
# board uses a Waveshare reflective-LCD panel driven over SPI by
# the display_rlcd.cpp backend. Code that is specific to this
# backend (the file-level guard in display_rlcd.cpp, etc.) keys
# off this symbol instead of the model id.
config DRAFTLING_DISPLAY_RLCD
    bool
    default y if DRAFTLING_MODEL_WAVESHARE_RLCD42
    default n

# DRAFTLING_DISPLAY_MIPI_DSI is set automatically when the selected
# board uses a MIPI-DSI color LCD driven through the ESP32-P4's
# DSI peripheral (currently only the M5Stack Tab5: ILI9881C or
# ST7123 panel depending on the hardware revision). The MIPI-DSI
# backend (components/display/display_mipi_dsi.cpp) is compiled in
# only when this symbol is set, keeping the m5stack_tab5 BSP
# managed-component dependency out of builds for other boards.
config DRAFTLING_DISPLAY_MIPI_DSI
    bool
    default y if DRAFTLING_MODEL_M5STACK_TAB5
    default n

# DRAFTLING_DISPLAY_RGB is set automatically when the selected board
# drives a parallel RGB565 color panel through the ESP32-S3 LCD RGB
# peripheral (esp_lcd_new_rgb_panel). The RGB backend
# (components/display/display_rgb.cpp) is compiled in only when this
# symbol is set. Currently only the Sunton ESP32-8048S070C.
config DRAFTLING_DISPLAY_RGB
    bool
    default y if DRAFTLING_MODEL_SUNTON_8048S070
    default y if DRAFTLING_MODEL_SUNTON_8048S043
    default n

# DRAFTLING_RGB_BOARD_S043 switches components/display/display_rgb.cpp
# to the Sunton ESP32-8048S043C panel definition (ST7262, 12.5 MHz
# pclk_active_neg, VSYNC=41/DE=40 control pins and R,G,B data-line
# order) instead of the default ESP32-8048S070C definition (12 MHz
# pclk_idle_high, VSYNC=40/DE=41 and B,G,R data-line order).
config DRAFTLING_RGB_BOARD_S043
    bool
    default y if DRAFTLING_MODEL_SUNTON_8048S043
    default n

# DRAFTLING_DISPLAY_CAN_ROTATE enables a runtime "Rotate 180" entry in
# the F1 -> Settings menu (persisted in NVS). It is offered on boards
# whose display backend implements the software 180-degree flip in
# lvgl_port.cpp's flush path. A 180 flip never changes the reported
# panel resolution, so it can be toggled at runtime without rebuilding
# the LVGL widget tree. Currently enabled on the parallel-RGB boards
# (the Sunton ESP32-8048S0xx family), where the USB-C / SD-card edge
# may be on either side depending on the enclosure.
config DRAFTLING_DISPLAY_CAN_ROTATE
    bool
    default y if DRAFTLING_DISPLAY_RGB
    default n

# DRAFTLING_DISPLAY_EPD is set automatically when the selected
# board has an electronic-paper panel. Code that has to be aware
# of e-paper specifics (slow refresh, no blinking cursor, white-on-
# sleep wipe, partial-refresh interval, etc.) keys off this
# symbol instead of the model id so adding a new e-paper board
# does not require touching every consumer.
config DRAFTLING_DISPLAY_EPD
    bool
    default y if DRAFTLING_MODEL_M5STACK_PAPERS3
    default y if DRAFTLING_MODEL_LILYGO_T5_EPD_S3_PRO
    default y if DRAFTLING_MODEL_LILYGO_T5_EPD_S3_PRO_H752
    default n

# DRAFTLING_DISPLAY_EPDIY is set automatically when the selected
# e-paper board is driven by the vroland/epdiy library. The set
# currently includes both LilyGO T5 E-Paper S3 Pro variants (driven
# by epdiy's built-in epd_board_v7: 8-bit parallel data bus + TPS65185
# high-voltage supply controlled via a PCA9535 I2C IO expander) and
# the M5Stack PaperS3 (driven by the in-tree epd_board_papers3.c:
# same 8-bit bus topology but with direct-GPIO power gates, no
# TPS65185 and no I/O expander). The EPDIY display backend
# (components/display/display_epdiy.cpp) is compiled in only when
# this symbol is set.
config DRAFTLING_DISPLAY_EPDIY
    bool
    default y if DRAFTLING_MODEL_LILYGO_T5_EPD_S3_PRO
    default y if DRAFTLING_MODEL_M5STACK_PAPERS3
    default n

# DRAFTLING_DISPLAY_H752_EPD selects the original LilyGO H752
# shift-register EPD47 backend. It is intentionally separate from
# DRAFTLING_DISPLAY_EPDIY because original H752 has no PCA9535 or
# TPS65185 and cannot use epdiy's epd_board_v7 path.
config DRAFTLING_DISPLAY_H752_EPD
    bool
    default y if DRAFTLING_MODEL_LILYGO_T5_EPD_S3_PRO_H752
    default n

# DRAFTLING_EPDIY_BOARD_PAPERS3 selects the in-tree PaperS3 board
# definition (components/display/epd_board_papers3.c) instead of
# epdiy's built-in epd_board_v7. The PaperS3 has no TPS65185 and no
# I/O expander; its EPD power rail is gated by two direct GPIO pins
# (EPD_EN on GPIO45, BST_EN on GPIO46).
config DRAFTLING_EPDIY_BOARD_PAPERS3
    bool
    default y if DRAFTLING_MODEL_M5STACK_PAPERS3
    default n

# DRAFTLING_DISPLAY_HAS_BACKLIGHT is set automatically on boards
# whose display backend drives a controllable backlight GPIO via
# LEDC PWM. The editor exposes a "Backlight" entry in the F1
# Settings menu (persisted in NVS) on these boards only.
config DRAFTLING_DISPLAY_HAS_BACKLIGHT
    bool
    default y if DRAFTLING_DISPLAY_AXS15231B
    default y if DRAFTLING_DISPLAY_MIPI_DSI
    default y if DRAFTLING_DISPLAY_RGB
    # LilyGO T5 E-Paper S3 Pro / Pro Lite carry a controllable white
    # front-light edge-lit LED on GPIO 11 (BOARD_BL_EN in the LilyGO
    # factory firmware). The EPDIY display backend drives it with
    # the standard LEDC PWM block, so the editor Settings menu and
    # Ctrl+B shortcut work on these boards too.
    default y if DRAFTLING_MODEL_LILYGO_T5_EPD_S3_PRO
    default y if DRAFTLING_MODEL_LILYGO_T5_EPD_S3_PRO_H752
    default n

# Minimum backlight percentage offered by the Settings menu. The
# editor cycles through the steps {0, 10, 25, 50, 75, 100} % (with
# an extra 5 % step on the LilyGO T5 E-Paper S3 Pro / Pro Lite
# front-light), but on some panels the lowest steps are too dark
# to be usable. Bumping this value drops the dim steps from the
# cycle so the user cannot accidentally land on an unreadable
# brightness. The 0 % step is
# only included when this value is 0 (it makes sense for reflective
# / e-paper panels that stay readable without any back/front-light;
# transmissive LCDs would just go fully dark). Non-prompted; set
# per model below.
config DRAFTLING_BACKLIGHT_MIN_PCT
    int
    depends on DRAFTLING_DISPLAY_HAS_BACKLIGHT
    # E-paper boards remain readable without the front-light, so let
    # the user dial brightness all the way down to 0 %.
    default 0 if DRAFTLING_MODEL_LILYGO_T5_EPD_S3_PRO
    default 0 if DRAFTLING_MODEL_LILYGO_T5_EPD_S3_PRO_H752
    default 10

# DRAFTLING_BL_DUTY_FLOOR_PCT shifts the bottom of the PWM duty
# range so that the lowest UI brightness steps are still visible
# on panels whose LED driver has a high "barely on" threshold.
# The backend remaps the user-facing 1..100 % linearly into
# [FLOOR..100] %% of full PWM duty: e.g. with FLOOR=40, user 10 %
# maps to 46 % duty, 25 % -> 55 %, 50 % -> 70 %, 100 % -> 100 %.
# A user setting of exactly 0 %% still produces duty 0 (fully off).
# Default 0 = no remap (linear). Non-prompted; set per model.
#
# Waveshare Touch-LCD-3.49: the backlight LED driver is invisible
# below ~45 % duty (10 % and 25 % look "completely dark"); a
# floor of 40 lets all five UI steps stay above the visibility
# threshold while still spanning a perceptible brightness range.
config DRAFTLING_BL_DUTY_FLOOR_PCT
    int
    depends on DRAFTLING_DISPLAY_HAS_BACKLIGHT
    default 40 if DRAFTLING_MODEL_WAVESHARE_TOUCH_LCD_349
    default 0

# DRAFTLING_BL_GPIO_BINARY tells the display backend to drive the
# backlight enable GPIO as a plain on/off digital output instead of
# an LEDC PWM channel. Kept available for future boards whose BL
# boost circuit does not tolerate LEDC PWM, but no current board
# defaults it to y. The polarity is taken from LCD_BL_ACTIVE_LOW in
# app_config.h (default 0 = active HIGH, 1 = active LOW), so the
# backend can drive the correct "on" / "off" level for either
# convention.
config DRAFTLING_BL_GPIO_BINARY
    bool
    default n

# DRAFTLING_HAS_BATTERY is set automatically on boards that wire
# the LiPo cell through a divider to an ADC pin (BATT_ADC_PIN >= 0
# in app_config.h). Used by the editor UI to decide whether to
# create the battery-percentage status-bar label and timer, instead
# of testing every model id individually.
config DRAFTLING_HAS_BATTERY
    bool
    default y if DRAFTLING_MODEL_WAVESHARE_RLCD42
    default y if DRAFTLING_MODEL_M5STACK_PAPERS3
    default y if DRAFTLING_MODEL_WAVESHARE_TOUCH_LCD_349
    # LilyGO T5 E-Paper S3 Pro / Pro Lite: battery is monitored via a
    # BQ27220 fuel gauge on I2C (driver in components/battery,
    # gated on DRAFTLING_BATTERY_BQ27220 below). The shared I2C
    # bus owned by main.cpp is passed to battery_init_bq27220().
    default y if DRAFTLING_MODEL_LILYGO_T5_EPD_S3_PRO
    default y if DRAFTLING_MODEL_LILYGO_T5_EPD_S3_PRO_H752
    # M5Stack Tab5: 2S NP-F550 Li-ion pack is monitored by an INA226
    # power monitor on the system I2C bus at 0x41 (see
    # DRAFTLING_BATTERY_INA226 below). main.cpp calls
    # battery_init_ina226() with the BSP-owned I2C handle.
    default y if DRAFTLING_MODEL_M5STACK_TAB5
    default n

# Selects the BQ27220 fuel-gauge backend in components/battery/
# instead of the GPIO ADC backend. main.cpp calls
# battery_init_bq27220(shared_i2c_bus) when this symbol is set, and
# the BQ27220 device is added to the shared I2C bus that already
# carries epdiy's TPS65185 / PCA9535 and the GT911 touch controller.
config DRAFTLING_BATTERY_BQ27220
    bool
    default y if DRAFTLING_MODEL_LILYGO_T5_EPD_S3_PRO
    default y if DRAFTLING_MODEL_LILYGO_T5_EPD_S3_PRO_H752
    default n

# Selects the TI INA226 bus-voltage backend in components/battery/.
# main.cpp calls battery_init_ina226(i2c_bus, 0x41, 2) when this
# symbol is set (Tab5 wires a 2S NP-F550 pack through the INA226).
# Percentage is derived from per-cell voltage via the same 4.2-3.6 V
# LiPo lookup table the ADC backend uses.
config DRAFTLING_BATTERY_INA226
    bool
    default y if DRAFTLING_MODEL_M5STACK_TAB5
    default n

# Enables the BQ25896 single-cell Li-ion charger init in
# components/battery (battery_init_bq25896). The chip lives on the
# shared I2C bus at 0x6B on the LilyGO T5 E-Paper S3 Pro / Pro Lite
# and ships with conservative defaults (500 mA IINLIM, 40 s I2C
# watchdog that reverts host writes, AUTO_DPDM that re-snaps IINLIM
# back to USB SDP). Without an explicit init the cell only charges
# at ~500 mA. main.cpp calls battery_init_bq25896(shared_i2c_bus)
# right after the shared bus is created when this symbol is set.
config DRAFTLING_CHARGER_BQ25896
    bool
    default y if DRAFTLING_MODEL_LILYGO_T5_EPD_S3_PRO
    default y if DRAFTLING_MODEL_LILYGO_T5_EPD_S3_PRO_H752
    default n

# Diagnostic power-management instrumentation. Off by default so it
# never noise-pollutes a production boot log. When set:
#   - On every cold boot, main.cpp dumps the full BQ27220 fuel-gauge
#     state (voltage, SoC, Flags, signed current in mA) and, if the
#     previous run persisted a sleep-entry timestamp + SoC, the
#     estimated deep-sleep drain rate in uA derived from the SoC delta.
#   - While the BQ25896 charger reports VBUS present, a 30-second
#     periodic task dumps REG00 / REG0B-REG13 so a sustained charge
#     can be characterised in-field without a USB power meter.
# Use this to confirm a deep-sleep change actually lowers idle draw
# and to localise charge tapering symptoms to the specific BQ25896
# status bit responsible (THERM_STAT, VDPM_STAT, NTC_FAULT, etc.).
config DRAFTLING_DEBUG_POWER
    bool "Enable verbose power-management diagnostics"
    default n
    help
        Adds a boot-time BQ27220 register dump, a deep-sleep drain
        estimator and a periodic BQ25896 charger-status dump. Useful
        for diagnosing battery drain and slow-charge regressions on
        the LilyGO T5 E-Paper S3 Pro / Pro Lite. Leave disabled in
        production builds.

# Periodically (every 30 s) re-asserts the most safety-critical
# BQ25896 settings -- ICO_EN=0 in REG02 and WATCHDOG=00 in REG07 --
# so a one-off bus glitch or a missed I2C write at boot cannot leave
# the charger in its 500 mA USB-SDP default. Independent of
# DRAFTLING_DEBUG_POWER so production builds still get the
# tamper-resistance without the verbose logs.
config DRAFTLING_CHARGER_WATCHDOG_REASSERT
    bool
    depends on DRAFTLING_CHARGER_BQ25896
    default y if DRAFTLING_CHARGER_BQ25896
    default n

# Enables the USB Host stack + USB HID keyboard driver
# (components/usb_kbd) on boards that wire a host-mode USB-A port.
# On M5Stack Tab5 the USB-A connector is gated by BSP_FEATURE_USB
# (PI4IOE5V6408 #2 P5); main.cpp brings it up before BLE so a
# physically attached USB keyboard preempts BLE pairing. If a USB
# keyboard is detected within DRAFTLING_USB_KBD_PROBE_MS at boot,
# the ble_keyboard component is left uninitialised.
config DRAFTLING_HAS_USB_HOST
    bool
    default y if DRAFTLING_MODEL_M5STACK_TAB5
    default n

config DRAFTLING_USB_KBD_PROBE_MS
    int
    depends on DRAFTLING_HAS_USB_HOST
    default 1500
    help
        Milliseconds main.cpp waits after bringing up the USB Host
        stack before deciding whether a USB keyboard is plugged in.
        1500 ms covers reset + enumeration + boot-protocol switch on
        all keyboards tested so far. If shorter, slow keyboards may
        miss the window and BLE will be brought up instead.

# Enables the M5Stack Tab5 attachable keyboard driver
# (components/tab5_kbd). The keyboard talks over its own dedicated
# I2C bus (address 0x6D) plus a dedicated interrupt line. main.cpp
# probes for it at boot; if present it feeds the editor alongside any
# USB keyboard, and BLE is left available on demand via the menu.
config DRAFTLING_HAS_TAB5_KBD
    bool
    default y if DRAFTLING_MODEL_M5STACK_TAB5
    default n

config DRAFTLING_TAB5_KBD_INT_GPIO
    int
    depends on DRAFTLING_HAS_TAB5_KBD
    default 50
    help
        GPIO wired to the Tab5 keyboard's interrupt (INT) line. The
        keyboard pulls this line low when a key event is queued; the
        driver reads the event over I2C on the falling edge.

config DRAFTLING_TAB5_KBD_I2C_SDA_GPIO
    int
    depends on DRAFTLING_HAS_TAB5_KBD
    default 0
    help
        SDA GPIO of the dedicated I2C bus the Tab5 keyboard is wired
        to. The keyboard does not share the system I2C bus (touch /
        IMU / codec); main.cpp creates a separate master bus on this
        pin pair for it.

config DRAFTLING_TAB5_KBD_I2C_SCL_GPIO
    int
    depends on DRAFTLING_HAS_TAB5_KBD
    default 1
    help
        SCL GPIO of the dedicated I2C bus the Tab5 keyboard is wired
        to. See DRAFTLING_TAB5_KBD_I2C_SDA_GPIO.

# DRAFTLING_HAS_POWER_LATCH is set automatically on boards that wire
# the battery rail through a hardware latch (typically a TCA9554 IO
# expander pin) so that the firmware can fully power the device off.
# The `power` component implements the latch + PWR button handling;
# when this symbol is set, the standby manager cuts the power latch
# instead of entering deep sleep on battery, and the editor exposes
# a Power-Off menu entry. Currently only the Waveshare ESP32-S3-
# Touch-LCD-3.49 wires this circuitry; on every other board the
# device falls back to a regular ESP32 deep-sleep cycle.
config DRAFTLING_HAS_POWER_LATCH
    bool
    default y if DRAFTLING_MODEL_WAVESHARE_TOUCH_LCD_349
    default n

# DRAFTLING_SD_SDMMC selects the on-chip SDMMC peripheral (1-bit
# mode) for SD card access. When unset, SD access goes through a
# generic SPI bus. Used by main.cpp's SD-init branch instead of
# testing per-board model ids.
config DRAFTLING_SD_SDMMC
    bool
    default y if DRAFTLING_MODEL_WAVESHARE_RLCD42
    default n

# DRAFTLING_WAKEUP_GPIO is the per-board RTC-capable GPIO used as
# the EXT0 deep-sleep wake source. Selected here so the standby
# component does not need to test individual model ids. The matching
# WAKEUP_GPIO_NUM macro in main/app_config.h is kept in lock-step
# for any code that includes app_config.h directly.
#
# When CONFIG_DRAFTLING_STANDBY_WAKE_ON_TOUCH is set the standby code
# arms EXT0 on CONFIG_DRAFTLING_TOUCH_INT_GPIO instead, regardless of
# this value.
config DRAFTLING_WAKEUP_GPIO
    int
    default 18 if DRAFTLING_MODEL_WAVESHARE_RLCD42
    default 0  if DRAFTLING_MODEL_M5STACK_PAPERS3
    default 0  if DRAFTLING_MODEL_WAVESHARE_TOUCH_LCD_349
    default 0  if DRAFTLING_MODEL_JC3248W535
    default 0  if DRAFTLING_MODEL_LILYGO_T5_EPD_S3_PRO
    default 48 if DRAFTLING_MODEL_LILYGO_T5_EPD_S3_PRO_H752
    # M5Stack Tab5 (ESP32-P4): no BOOT button is wired to an LP_IO
    # (the only LP_IO range on the P4 is GPIO0-15), so there is no
    # GPIO wake source available. On Tab5 standby enters real deep
    # sleep and the only wake path is the hardware RESET button --
    # the chip cold-boots and the editor restores from autosave.
    # This value is set anyway for code paths that reference
    # WAKEUP_GPIO_NUM directly but no EXT0/LP_IO arming is done on
    # the P4 (see standby.cpp).
    default 0  if DRAFTLING_MODEL_M5STACK_TAB5
    default 0  if DRAFTLING_MODEL_SUNTON_8048S070
    default 0  if DRAFTLING_MODEL_SUNTON_8048S043
    default 0

# ---- Touchscreen support ----
#
# DRAFTLING_TOUCHSCREEN enables an I2C touch-controller driver
# (currently only the AXS5106L on the Guition JC3248W535) and an
# LVGL pointer input device. When enabled, the editor accepts tap
# (move cursor), vertical swipe (scroll), and double-tap (select
# word) gestures; list screens (main menu, settings, file browser)
# accept tap-to-select on rows.
#
# The default is on for boards that have no user buttons besides the
# power switch (Guition JC3248W535).
config DRAFTLING_TOUCHSCREEN
    bool "Enable touchscreen input"
    default y if DRAFTLING_MODEL_JC3248W535
    default y if DRAFTLING_MODEL_M5STACK_PAPERS3
    default y if DRAFTLING_MODEL_WAVESHARE_TOUCH_LCD_349
    default y if DRAFTLING_MODEL_M5STACK_TAB5
    # LilyGO T5 E-Paper S3 Pro / Pro Lite carry a GT911 capacitive
    # touch controller on the same on-board I2C bus as epdiy's
    # PCA9535 I/O expander + TPS65185 power-management IC. epdiy is
    # pinned (see components/display/idf_component.yml) to a post-
    # 2.0.0 commit that migrates its on-board I2C to driver-NG and
    # accepts a caller-supplied i2c_master_bus_handle_t via
    # epd_init_with_config(). main.cpp creates the bus once, hands
    # it to the display backend (display_set_shared_i2c_bus) and
    # to the touchscreen component (touchscreen_config_t.i2c_bus),
    # so the two driver-NG consumers coexist on a single I2C port.
    # Both Pro and Pro Lite physically populate the GT911 (see the
    # H752-01 schematic and the per-board comment in app_config.h),
    # so default touch on for both SKUs.
    default y if DRAFTLING_MODEL_LILYGO_T5_EPD_S3_PRO
    default y if DRAFTLING_MODEL_LILYGO_T5_EPD_S3_PRO_H752
    default n
    help
        Enable I2C touch-controller support and an LVGL pointer
        input device. The editor and list screens become
        touch-navigable in addition to the keyboard. Required on
        boards that have no user buttons.

# Touch controller silicon. Each model wires a different I2C chip
# (AXS5106L on the Guition JC3248W535, GT911 on the M5Stack
# PaperS3). The touchscreen component carries one driver per
# controller and dispatches at build time on these symbols.
#
# Both are non-prompted derived bools so the value tracks the
# hardware-model choice automatically (no stickiness in sdkconfig).
config DRAFTLING_TOUCH_AXS5106L
    bool
    depends on DRAFTLING_TOUCHSCREEN
    default y if DRAFTLING_MODEL_JC3248W535
    default y if DRAFTLING_MODEL_WAVESHARE_TOUCH_LCD_349
    default n
    help
        Allystar AXS5106L / AXS5106. Uses a fixed 8-byte read-request
        magic packet over I2C and returns one touch point. Default
        I2C address 0x3B.

config DRAFTLING_TOUCH_GT911
    bool
    depends on DRAFTLING_TOUCHSCREEN
    default y if DRAFTLING_MODEL_M5STACK_PAPERS3
    default y if DRAFTLING_MODEL_LILYGO_T5_EPD_S3_PRO
    default y if DRAFTLING_MODEL_LILYGO_T5_EPD_S3_PRO_H752
    default y if DRAFTLING_MODEL_M5STACK_TAB5
    default y if DRAFTLING_MODEL_SUNTON_8048S070
    default y if DRAFTLING_MODEL_SUNTON_8048S043
    default n
    help
        Goodix GT911. Register-addressed protocol: 16-bit register
        address sent MSB-first, status byte at 0x814E, touch points
        at 0x814F+. Default I2C address 0x5D (0x14 as backup).

# Touchscreen INT GPIO. The touch controller pulses this line low
# on touch. Used by the LVGL pointer indev (the read_cb only polls
# I2C when INT is low to avoid bus noise on every LVGL tick) and,
# when CONFIG_DRAFTLING_STANDBY_WAKE_ON_TOUCH is set, as the EXT0
# deep-sleep wake source. Must be RTC-capable (GPIO0-21 on the
# ESP32-S3) for the wake-on-touch path to work.
#
# Non-prompted: derived from the hardware-model choice. Defaults
# verified for: Guition JC3248W535 (GPIO3, AXS5106L), M5Stack
# PaperS3 (GPIO48, GT911).
config DRAFTLING_TOUCH_INT_GPIO
    int
    depends on DRAFTLING_TOUCHSCREEN
    range -1 54
    default 3  if DRAFTLING_MODEL_JC3248W535
    default 48 if DRAFTLING_MODEL_M5STACK_PAPERS3
    default 3  if DRAFTLING_MODEL_LILYGO_T5_EPD_S3_PRO
    default 15 if DRAFTLING_MODEL_LILYGO_T5_EPD_S3_PRO_H752
    # M5Stack Tab5: GT911 INT on GPIO23. main.cpp pre-drives this
    # pin LOW *and* power-cycles BSP_TOUCH_EN (PI4IOE5V6408 #1, IO5)
    # before display_init() so the GT911 actually re-runs its
    # internal POR with INT low and latches its backup I2C address
    # 0x14 (the BSP only ever probes 0x14; a hardware 3V3 pull-up
    # on INT would otherwise force the primary 0x5D path which the
    # board does not route). The power-cycle is what makes this
    # work across warm reboots, where TOUCH_EN was already high
    # from the previous boot and the GT911 had already latched
    # 0x5D before we got control.
    # ESP32-P4 GPIO23 is not LP_IO so EXT0/EXT1/LP_IO deep-sleep wake
    # on this pin is unavailable: standby on Tab5 therefore enters
    # real deep sleep with NO GPIO wake source and the only wake
    # path is the hardware RESET button (cold boot, autosave is
    # restored). DRAFTLING_STANDBY_WAKE_ON_TOUCH must NOT be set
    # on Tab5 -- it would try to arm EXT0 on a non-LP_IO pin.
    default 23 if DRAFTLING_MODEL_M5STACK_TAB5
    default -1

# Touchscreen reset GPIO. The reset line is often tied to the LCD
# reset on combo touch+LCD boards; set to -1 to skip a software
# reset pulse during touchscreen_init.
#
# Non-prompted: derived from the hardware-model choice. On all
# currently-supported touch boards RST is tied to the LCD reset
# or a fixed pull-up, so the default is -1.
config DRAFTLING_TOUCH_RST_GPIO
    int
    depends on DRAFTLING_TOUCHSCREEN
    range -1 54
    default 9  if DRAFTLING_MODEL_LILYGO_T5_EPD_S3_PRO
    default 41 if DRAFTLING_MODEL_LILYGO_T5_EPD_S3_PRO_H752
    default 38 if DRAFTLING_MODEL_SUNTON_8048S070
    default 38 if DRAFTLING_MODEL_SUNTON_8048S043
    default -1

config DRAFTLING_TOUCH_DEBUG_LOG
    bool "Log every raw/logical touch coordinate (verbose)"
    depends on DRAFTLING_TOUCHSCREEN
    default n
    help
        Emit an INFO-level log line on every successful touch poll
        with the raw native coordinates from the controller and
        the logical (post-transform) coordinates handed to LVGL.

        Useful when bringing up a new touch panel to dial in
        TOUCH_SWAP_XY / TOUCH_MIRROR_X / TOUCH_MIRROR_Y in
        app_config.h. Spammy during normal use, so leave off in
        production builds.

# ---- Standby behavior ----
#
# By default the standby manager enters real ESP32 deep sleep on
# inactivity (or on "no keyboard within N seconds"). On boards with
# no buttons that can wake the chip, two alternative paths are
# available:
#
#   * DRAFTLING_STANDBY_DISPLAY_OFF -- keep the MCU running but blank
#     the display (clear framebuffer + backlight off + DISPOFF + SLPIN
#     on backends that support it). Wakes on any LVGL input event.
#
#   * DRAFTLING_STANDBY_WAKE_ON_TOUCH -- on deep sleep, arm EXT0 on
#     the touch INT pin instead of the BOOT button. Lets a touch wake
#     the device from real deep sleep. Requires DRAFTLING_TOUCHSCREEN
#     and a touch INT pin on an RTC-capable GPIO (GPIO0-21).
#
# When both are set the WAKE_ON_TOUCH path is preferred (it draws
# less power than keeping the MCU running). When neither is set the
# behavior is the existing BOOT-button EXT0 wake.
#
# On the Guition JC3248W535 (no user buttons) we default to deep
# sleep + wake-on-touch.
config DRAFTLING_STANDBY_DISPLAY_OFF
    bool "Standby: turn display off (keep MCU running) instead of deep sleep"
    default n
    help
        On standby, blank the display and put the panel into its
        low-power sleep mode instead of deep-sleeping the MCU.
        Any LVGL input event (touch, BLE keyboard) wakes the
        display.

        Use this on boards with no RTC-capable wake source (no
        BOOT button on an RTC GPIO and no touch INT on an RTC
        GPIO). It draws more power than deep sleep -- prefer
        DRAFTLING_STANDBY_WAKE_ON_TOUCH if you have a touch
        controller wired to an RTC GPIO.

config DRAFTLING_STANDBY_WAKE_ON_TOUCH
    bool "Standby: wake from deep sleep on touchscreen tap"
    depends on DRAFTLING_TOUCHSCREEN
    default y if DRAFTLING_MODEL_JC3248W535
    default n
    help
        On standby, enter real deep sleep and arm EXT0 on the
        touch INT line so any tap wakes the device. Requires
        DRAFTLING_TOUCH_INT_GPIO to be on an RTC-capable GPIO
        (0-21 on ESP32-S3).

        When this is set the touch INT pin overrides
        DRAFTLING_WAKEUP_GPIO as the deep-sleep wake source.

config DRAFTLING_DISPLAY_WIDTH
    int
    range 64 2048
    default 400 if DRAFTLING_MODEL_WAVESHARE_RLCD42
    default 960 if DRAFTLING_MODEL_M5STACK_PAPERS3
    default 960 if DRAFTLING_MODEL_LILYGO_T5_EPD_S3_PRO
    default 960 if DRAFTLING_MODEL_LILYGO_T5_EPD_S3_PRO_H752
    default 640 if DRAFTLING_MODEL_WAVESHARE_TOUCH_LCD_349
    default 480 if DRAFTLING_MODEL_JC3248W535
    default 720 if DRAFTLING_MODEL_M5STACK_TAB5
    default 800 if DRAFTLING_MODEL_SUNTON_8048S070
    default 800 if DRAFTLING_MODEL_SUNTON_8048S043
    help
        Display width in pixels (derived). Driven by the hardware-model
        choice. Must be a multiple of 8 for e-paper backends.

config DRAFTLING_DISPLAY_HEIGHT
    int
    range 64 2048
    default 300 if DRAFTLING_MODEL_WAVESHARE_RLCD42
    default 540 if DRAFTLING_MODEL_M5STACK_PAPERS3
    default 540 if DRAFTLING_MODEL_LILYGO_T5_EPD_S3_PRO
    default 540 if DRAFTLING_MODEL_LILYGO_T5_EPD_S3_PRO_H752
    default 172 if DRAFTLING_MODEL_WAVESHARE_TOUCH_LCD_349
    default 320 if DRAFTLING_MODEL_JC3248W535
    default 1280 if DRAFTLING_MODEL_M5STACK_TAB5
    default 480 if DRAFTLING_MODEL_SUNTON_8048S070
    default 480 if DRAFTLING_MODEL_SUNTON_8048S043
    help
        Display height in pixels (derived). Driven by the hardware-model
        choice.

choice DRAFTLING_DISPLAY_ROTATE
    prompt "Display rotation angle"
    default DRAFTLING_DISPLAY_ROTATE_270 if DRAFTLING_MODEL_M5STACK_TAB5
    default DRAFTLING_DISPLAY_ROTATE_0
    help
        Rotation angle for the display in degrees.

config DRAFTLING_DISPLAY_ROTATE_0
    bool "0 degrees (no rotation)"

config DRAFTLING_DISPLAY_ROTATE_90
    bool "90 degrees"

config DRAFTLING_DISPLAY_ROTATE_180
    bool "180 degrees"

config DRAFTLING_DISPLAY_ROTATE_270
    bool "270 degrees"

endchoice

config DRAFTLING_DISPLAY_ROTATE_ANGLE
    int
    default 0 if DRAFTLING_DISPLAY_ROTATE_0
    default 90 if DRAFTLING_DISPLAY_ROTATE_90
    default 180 if DRAFTLING_DISPLAY_ROTATE_180
    default 270 if DRAFTLING_DISPLAY_ROTATE_270

# DRAFTLING_DISPLAY_SCALE -- logical pixel size in physical panel
# pixels. Non-prompted derived int so the per-board default tracks
# the hardware-model choice automatically (no stickiness in
# sdkconfig). Override via sdkconfig.defaults if you need a value
# other than the per-board default.
#
# Every logical LVGL pixel is rendered as SCALE x SCALE physical
# panel pixels via nearest-neighbor expansion in the display
# backend. The editor and LVGL canvas operate in logical
# coordinates (panel size divided by SCALE); only the display
# backend scales up when pushing to the panel. Larger values give
# bigger text at the cost of less screen real estate.
#
# Defaults: 2 for the M5Stack PaperS3 (whose 540x960 panel is
# dense enough that 1:1 Greybeard text is uncomfortably small),
# 1 everywhere else (one LVGL pixel == one panel pixel).
# Currently only the M5Stack PaperS3 and JC3248W535
# backends implement the up-scaling; on the RLCD backend SCALE > 1
# has no visible effect.
config DRAFTLING_DISPLAY_SCALE
    int
    range 1 8
    default 2 if DRAFTLING_MODEL_M5STACK_PAPERS3
    default 2 if DRAFTLING_MODEL_LILYGO_T5_EPD_S3_PRO
    default 2 if DRAFTLING_MODEL_LILYGO_T5_EPD_S3_PRO_H752
    # M5Stack Tab5 1280x720 panel is dense (5", ~293 DPI); a 2x
    # scale brings the editor canvas down to 640x360 logical
    # pixels, comfortable for Greybeard-sized text.
    default 2 if DRAFTLING_MODEL_M5STACK_TAB5
    # Sunton ESP32-8048S070C 800x480 7" panel (~133 DPI); a 2x scale
    # brings the editor canvas down to 400x240 logical pixels for
    # comfortably large Greybeard text.
    default 2 if DRAFTLING_MODEL_SUNTON_8048S070
    # Sunton ESP32-8048S043C 800x480 4.3" panel (~217 DPI); the denser
    # panel needs the same 2x scale to keep Greybeard text comfortably
    # large (400x240 logical pixels).
    default 2 if DRAFTLING_MODEL_SUNTON_8048S043
    default 1
config DRAFTLING_EPD_FULL_REFRESH_INTERVAL
    int "E-paper full-refresh interval (partial updates between full refreshes)"
    depends on DRAFTLING_DISPLAY_EPD
    range 1 1000
    default 30
    help
        How many partial refreshes the e-paper driver performs before it
        forces a full refresh to clear residual ghosting. Lower values
        give cleaner pixels at the cost of more frequent slow (3-5 s)
        full refreshes; higher values keep the UI snappy but let
        ghosting accumulate. The default of 30 is a reasonable balance
        for a Markdown editor; the M5Stack PaperS3 backend uses the
        single-pulse epd_fast waveform for partial refreshes, which is
        faster than the older two-pass epd_text but accumulates
        ghosting slightly more quickly.

config DRAFTLING_EPD_BLACK_BACKGROUND
    bool "Black background (white text on black)"
    depends on DRAFTLING_DISPLAY_EPD
    default n
    help
        When enabled, the editor renders white text on a black
        background instead of the default black text on a white
        background. Applies to the editor, file browser, menu, settings
        and all overlay dialogs. Selection and active-row highlights
        are inverted accordingly (they become black-on-white).

        Available only on e-paper boards. The screen is still wiped to
        white before deep sleep regardless of this setting, so the
        panel is left in a clean state while the MCU is asleep.

config DRAFTLING_NO_KEYBOARD_SLEEP_SEC
    int "Deep-sleep timeout when no keyboard connects (s)"
    range 0 3600
    default 0 if DRAFTLING_MODEL_LILYGO_T5_EPD_S3_PRO_H752
    default 180
    help
        If no Bluetooth keyboard connects within this many seconds
        after boot, the device enters deep sleep to conserve battery.
        Useful when the device is powered on accidentally or the
        previously-paired keyboard is unavailable.

        Set to 0 to disable -- the device will then keep scanning
        indefinitely. The countdown is cancelled the first time a
        keyboard connects; after that the regular inactivity timeout
        (settable from the editor's F1 menu and persisted in NVS)
        takes over.

        Default is 180 seconds (3 minutes).


endmenu
```
