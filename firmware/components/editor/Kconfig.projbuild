## sdkconfig.defaults.h752
```kconfig
# Draftling original LilyGO T5 E-Paper S3 Pro H752 defaults.
#
# Build with:
#   idf.py -D SDKCONFIG_DEFAULTS="sdkconfig.defaults;sdkconfig.defaults.esp32s3;sdkconfig.defaults.h752" build

CONFIG_DRAFTLING_MODEL_LILYGO_T5_EPD_S3_PRO_H752=y
CONFIG_DRAFTLING_DISPLAY_ROTATE_0=y
CONFIG_KB_LAYOUT_ENABLE_HE=y
CONFIG_DRAFTLING_NO_KEYBOARD_SLEEP_SEC=0
```

## sdkconfig.defaults.sunton
```kconfig
# Sunton ESP32-8048S070C board selection + board-specific tuning.
# Pass alongside the common defaults via:
#   idf.py -D SDKCONFIG_DEFAULTS="sdkconfig.defaults;sdkconfig.defaults.esp32s3;sdkconfig.defaults.sunton" build

CONFIG_DRAFTLING_MODEL_SUNTON_8048S070=y

# The Sunton board's flash is wired for DIO (verified working on this
# hardware in the parallel breezydemo port). Override the common QIO
# default so the bootloader comes up reliably.
CONFIG_ESPTOOLPY_FLASHMODE_DIO=y

# Enable the on-board GT911 capacitive touchscreen as a secondary
# input device (cursor / scroll / tap-to-select). The GT911 INT line
# is not wired on the Sunton reference (polled every LVGL tick) and
# RST is on GPIO38 (derived in Kconfig).
CONFIG_DRAFTLING_TOUCHSCREEN=y
```

## sdkconfig.defaults.sunton043
```kconfig
# Sunton ESP32-8048S043C board selection + board-specific tuning.
# Pass alongside the common defaults via:
#   idf.py -D SDKCONFIG_DEFAULTS="sdkconfig.defaults;sdkconfig.defaults.esp32s3;sdkconfig.defaults.sunton043" build

CONFIG_DRAFTLING_MODEL_SUNTON_8048S043=y

# The Sunton ESP32-8048S0xx boards' flash is wired for DIO (verified
# working on this hardware in the parallel breezydemo port). Override
# the common QIO default so the bootloader comes up reliably.
CONFIG_ESPTOOLPY_FLASHMODE_DIO=y

# Enable the on-board GT911 capacitive touchscreen as a secondary
# input device (cursor / scroll / tap-to-select). The GT911 INT line
# is not wired on the Sunton reference (polled every LVGL tick) and
# RST is on GPIO38 (derived in Kconfig).
CONFIG_DRAFTLING_TOUCHSCREEN=y

# Keyboard layouts: this board ships with a German BLE keyboard, so
# make US (QWERTY) and DE (QWERTZ) the two available layouts (cycle
# with Ctrl+L / Win+Space). Disable the Ukrainian layout that is on
# by default in the common Kconfig.
CONFIG_KB_LAYOUT_ENABLE_US=y
CONFIG_KB_LAYOUT_ENABLE_DE=y
CONFIG_KB_LAYOUT_ENABLE_UA=n
CONFIG_KB_LAYOUT_ENABLE_FR=n
CONFIG_KB_LAYOUT_ENABLE_HE=n
```
