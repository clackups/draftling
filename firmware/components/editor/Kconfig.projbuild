## firmware/components/editor/Kconfig.projbuild
```kconfig
menu "DRAFTLING Editor"

config DRAFTLING_KEY_QUEUE_LEN
    int "Key event queue length"
    range 4 256
    default 32
    help
        Size of the FreeRTOS queue that buffers key events from the BLE
        HID host task before they are drained by the LVGL GUI task.
        Larger values absorb bursts of keystrokes at the cost of a bit
        more RAM (each slot is a kb_event_t).

config DRAFTLING_KEY_DRAIN_PERIOD_MS
    int "Key event drain period (ms)"
    range 1 1000
    default 20
    help
        Period of the LVGL timer that drains the BLE key event queue on
        the GUI task. The default of 20 ms gives a 50 Hz poll rate.
        Lower values reduce input latency at the cost of more CPU
        wakeups; higher values save power but feel less responsive.

endmenu
```

## firmware/sdkconfig.defaults.esp32s3
```kconfig
# ESP32-S3-specific defaults
# Applied automatically when: idf.py set-target esp32s3

CONFIG_ESPTOOLPY_FLASHMODE_QIO=y
CONFIG_ESPTOOLPY_FLASHSIZE_16MB=y

# PSRAM
CONFIG_SPIRAM=y
CONFIG_SPIRAM_MODE_OCT=y
CONFIG_SPIRAM_SPEED_80M=y
CONFIG_SPIRAM_ALLOW_STACK_EXTERNAL_MEMORY=y
# Push WiFi/LWIP dynamic allocations to PSRAM to free internal DRAM.
# WiFi static RX buffers still must live in internal DMA-capable RAM,
# so their count is bounded below by sdkconfig (see WiFi section).
CONFIG_SPIRAM_TRY_ALLOCATE_WIFI_LWIP=y

# Bluetooth (BLE only -- ESP32-S3 has no Classic BT support)
CONFIG_BT_ENABLED=y
CONFIG_BT_BLUEDROID_ENABLED=y
CONFIG_BT_BLE_ENABLED=y
CONFIG_BT_GATTC_ENABLE=y
CONFIG_BT_BLE_42_FEATURES_SUPPORTED=y
CONFIG_BT_ALLOCATION_FROM_SPIRAM_FIRST=y
CONFIG_BT_BLE_SMP_ENABLE=y
CONFIG_BT_HID_HOST_ENABLED=y

# WiFi
# Static RX buffers (1600 B each) are allocated from internal DMA-capable
# RAM and cannot be moved to PSRAM. On boards that share internal DRAM
# with a large display framebuffer (M5Stack PaperS3: epdiy keeps a 4-bpp
# 540x960 grayscale buffer in internal RAM) and Bluedroid, only a handful
# of these slots fit. Setting this to 16 caused esp_wifi_init() to fail
# with ESP_ERR_NO_MEM on PaperS3 ("Expected to init 16 rx buffer, actual
# is 4"). Use a value that fits on the most memory-constrained supported
# board; dynamic RX/TX buffers below pick up the slack from PSRAM via
# CONFIG_SPIRAM_TRY_ALLOCATE_WIFI_LWIP.
CONFIG_ESP_WIFI_STATIC_RX_BUFFER_NUM=4
CONFIG_ESP_WIFI_DYNAMIC_RX_BUFFER_NUM=32
# RX BA window must be <= 2 * static_rx_buffer_num (IDF constraint).
CONFIG_ESP_WIFI_RX_BA_WIN=6
# Move RX-management buffers from the WiFi static internal-RAM pool to
# the regular heap (which lands in PSRAM thanks to
# SPIRAM_TRY_ALLOCATE_WIFI_LWIP above). Without this, esp_wifi_init()
# fails on PaperS3 with
#   wifi:esf_buf_setup_static: alloc eb fail(1)
#   WiFiMgr: esp_wifi_init failed: ESP_ERR_NO_MEM
# whenever the user starts a Git sync while the BLE keyboard is paired
# (Bluedroid + epdiy have already consumed most of the internal DRAM by
# then, so even one extra static eb does not fit).
CONFIG_ESP_WIFI_DYNAMIC_RX_MGMT_BUF=1
# Minimum count for the few mgmt short buffers that remain static (the
# IDF lower bound is 6). Default is 32, which is wasteful for a station
# that only ever talks to one AP for HTTPS Git sync.
CONFIG_ESP_WIFI_MGMT_SBUF_NUM=6
# Disable A-MPDU aggregation. Each direction reserves additional
# internal-RAM aggregation/reorder buffers, and Git sync over HTTPS
# does not need the throughput. Saves several KB of internal DRAM.
CONFIG_ESP_WIFI_AMPDU_TX_ENABLED=n
CONFIG_ESP_WIFI_AMPDU_RX_ENABLED=n
```
