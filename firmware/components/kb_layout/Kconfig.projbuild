## firmware/components/kb_layout/Kconfig.projbuild
```kconfig
menu "DRAFTLING Language Pack and Keyboard Layouts"

choice DRAFTLING_LANG_PACK
    prompt "Language pack"
    default DRAFTLING_LANG_PACK_DEFAULT
    help
        A language pack is the set of keyboard layouts, input methods
        and font subsets compiled into the firmware. Each pack is a
        separate firmware image; build one with
        "idf.py --preset <board> --lang-pack <pack> build" (see
        BUILDING.md). The pack only sets the defaults of the layout
        options below -- each layout can still be switched on or off
        individually.

    config DRAFTLING_LANG_PACK_DEFAULT
        bool "Default (US, Ukrainian, German, French, Hebrew and 17 more European and Canadian layouts)"

    config DRAFTLING_LANG_PACK_VIETNAMESE
        bool "Vietnamese (US, Vietnamese Telex)"
        help
            US-English plus Vietnamese typed with the Telex input
            method, and the Vietnamese letters of the fonts.

    config DRAFTLING_LANG_PACK_KOREAN
        bool "Korean (US, Korean 2-set Hangul)"
        help
            US-English plus Korean (Dubeolsik), with the Hangul pixel
            fonts (all 11,172 syllables).

    config DRAFTLING_LANG_PACK_JAPANESE
        bool "Japanese (US, romaji -> kana -> kanji)"
        help
            US-English plus Japanese input with kana-kanji conversion
            (Mozc-derived dictionary, about 1 MB), with the kana and
            JIS X 0208 kanji pixel fonts in Japanese glyph style.

    config DRAFTLING_LANG_PACK_CHINESE
        bool "Chinese (US, Simplified Chinese pinyin)"
        help
            US-English plus Simplified Chinese pinyin input (AOSP
            PinyinIME dictionary, about 1 MB), with the GB 2312 hanzi
            pixel fonts in Simplified Chinese glyph style.

    config DRAFTLING_LANG_PACK_INDIC
        bool "Indic (US, Devanagari, Tamil)"
        help
            US-English plus the Devanagari script (Hindi and Marathi
            InScript, Nepali Traditional and Romanized layouts) and
            Tamil (Tamil 99, Tamil Typewriter, InScript and the
            Taravinyas input engine), with glyphs from Noto Sans
            Devanagari and Noto Sans Tamil. Devanagari text is shaped
            on the device with HarfBuzz.

endchoice

config DRAFTLING_LANG_PACK_NAME
    string
    default "default" if DRAFTLING_LANG_PACK_DEFAULT
    default "vietnamese" if DRAFTLING_LANG_PACK_VIETNAMESE
    default "korean" if DRAFTLING_LANG_PACK_KOREAN
    default "japanese" if DRAFTLING_LANG_PACK_JAPANESE
    default "chinese" if DRAFTLING_LANG_PACK_CHINESE
    default "indic" if DRAFTLING_LANG_PACK_INDIC

config KB_LAYOUT_ENABLE_US
    bool "US-English (QWERTY)"
    default y
    help
        Enable the US-English QWERTY keyboard layout.

config KB_LAYOUT_ENABLE_UA
    bool "Ukrainian (Cyrillic)"
    default y if DRAFTLING_LANG_PACK_DEFAULT
    help
        Enable the Ukrainian Cyrillic keyboard layout.

config KB_LAYOUT_ENABLE_DE
    bool "German (QWERTZ)"
    default y if DRAFTLING_LANG_PACK_DEFAULT
    help
        Enable the German QWERTZ keyboard layout with umlauts.

config KB_LAYOUT_ENABLE_FR
    bool "French (AZERTY)"
    default y if DRAFTLING_LANG_PACK_DEFAULT
    help
        Enable the French AZERTY keyboard layout with accents.

config KB_LAYOUT_ENABLE_HE
    bool "Hebrew (Israeli standard)"
    default y if DRAFTLING_LANG_PACK_DEFAULT
    help
        Enable the Hebrew (Israeli standard SI 1452) keyboard layout.
        Enabling this option also pulls the Hebrew glyph range
        (U+0590..U+05FF) of the Greybeard font into the firmware.
        Hebrew typing is right-to-left; LVGL's bidirectional text
        engine (LV_USE_BIDI) handles the visual reordering.

config KB_LAYOUT_ENABLE_DE_CH
    bool "Swiss German (QWERTZ)"
    default y if DRAFTLING_LANG_PACK_DEFAULT
    help
        Enable the Swiss German QWERTZ keyboard layout (umlauts on
        their own keys, e-acute / e-grave / a-grave shifted; accent
        dead keys).

config KB_LAYOUT_ENABLE_FR_CH
    bool "Swiss French (QWERTZ)"
    default y if DRAFTLING_LANG_PACK_DEFAULT
    help
        Enable the Swiss French QWERTZ keyboard layout (e-acute /
        e-grave / a-grave on their own keys, umlauts shifted; accent
        dead keys).

config KB_LAYOUT_ENABLE_IT
    bool "Italian (QWERTY)"
    default y if DRAFTLING_LANG_PACK_DEFAULT
    help
        Enable the Italian QWERTY keyboard layout with accented
        vowels.

config KB_LAYOUT_ENABLE_PT
    bool "Portuguese (Portugal, QWERTY)"
    default y if DRAFTLING_LANG_PACK_DEFAULT
    help
        Enable the Portuguese (Portugal) QWERTY keyboard layout with
        c-cedilla and the acute / grave / tilde / circumflex dead keys.

config KB_LAYOUT_ENABLE_ES
    bool "Spanish (Spain, QWERTY)"
    default y if DRAFTLING_LANG_PACK_DEFAULT
    help
        Enable the Spanish (Spain) QWERTY keyboard layout with n-tilde
        and the acute / grave / circumflex / diaeresis dead keys.

config KB_LAYOUT_ENABLE_GB
    bool "United Kingdom (QWERTY)"
    default y if DRAFTLING_LANG_PACK_DEFAULT
    help
        Enable the United Kingdom QWERTY keyboard layout (pound sign
        on Shift+3, @ on Shift+', AltGr + vowel for acute vowels).

config KB_LAYOUT_ENABLE_SE_FI
    bool "Swedish / Finnish (QWERTY)"
    default y if DRAFTLING_LANG_PACK_DEFAULT
    help
        Enable the Swedish / Finnish QWERTY keyboard layout (a-ring, a / o-umlaut;
        accent dead keys). Pulls in the Latin Extended-A font
        subset.

config KB_LAYOUT_ENABLE_NO
    bool "Norwegian (QWERTY)"
    default y if DRAFTLING_LANG_PACK_DEFAULT
    help
        Enable the Norwegian QWERTY keyboard layout (a-ring, ae, o-slash; accent
        dead keys). Pulls in the Latin Extended-A font
        subset.

config KB_LAYOUT_ENABLE_DK
    bool "Danish (QWERTY)"
    default y if DRAFTLING_LANG_PACK_DEFAULT
    help
        Enable the Danish QWERTY keyboard layout (a-ring, ae, o-slash; accent
        dead keys). Pulls in the Latin Extended-A font
        subset.

config KB_LAYOUT_ENABLE_PL
    bool "Polish (programmers, QWERTY)"
    default y if DRAFTLING_LANG_PACK_DEFAULT
    help
        Enable the Polish programmers layout: US QWERTY with the Polish letters
        on AltGr + letter. Pulls in the Latin Extended-A font
        subset.

config KB_LAYOUT_ENABLE_CZ
    bool "Czech (QWERTZ)"
    default y if DRAFTLING_LANG_PACK_DEFAULT
    help
        Enable the Czech QWERTZ keyboard layout (accented letters on the number
        row; acute, caron and ring dead keys). Pulls in the Latin Extended-A font
        subset.

config KB_LAYOUT_ENABLE_SK
    bool "Slovak (QWERTZ)"
    default y if DRAFTLING_LANG_PACK_DEFAULT
    help
        Enable the Slovak QWERTZ keyboard layout (accented letters on the number
        row; acute, caron and ring dead keys). Pulls in the Latin Extended-A font
        subset.

config KB_LAYOUT_ENABLE_HU
    bool "Hungarian (QWERTZ)"
    default y if DRAFTLING_LANG_PACK_DEFAULT
    help
        Enable the Hungarian QWERTZ keyboard layout (every Hungarian letter on its
        own key). Pulls in the Latin Extended-A font
        subset.

config KB_LAYOUT_ENABLE_RO
    bool "Romanian (standard, QWERTY)"
    default y if DRAFTLING_LANG_PACK_DEFAULT
    help
        Enable the Romanian standard QWERTY keyboard layout (s / t with comma
        below, a-breve, a / i-circumflex). Pulls in the Latin Extended-A font
        subset.

config KB_LAYOUT_ENABLE_HR
    bool "Croatian / Slovenian (QWERTZ)"
    default y if DRAFTLING_LANG_PACK_DEFAULT
    help
        Enable the Croatian / Slovenian QWERTZ keyboard layout (s / c / z-caron,
        c-acute, d-stroke). Pulls in the Latin Extended-A font
        subset.

config KB_LAYOUT_ENABLE_TR
    bool "Turkish Q (QWERTY)"
    default y if DRAFTLING_LANG_PACK_DEFAULT
    help
        Enable the Turkish Q keyboard layout (dotless i, g-breve, s-cedilla). Pulls in the Latin Extended-A font
        subset.

config KB_LAYOUT_ENABLE_FR_CA
    bool "Canadian French, traditional (QWERTY)"
    default y if DRAFTLING_LANG_PACK_DEFAULT
    help
        Enable the traditional Canadian French QWERTY keyboard layout
        (Windows "Canadian French", XKB "ca"): e-acute on its own key,
        circumflex / cedilla / diaeresis / grave dead keys, guillemets
        on the key left of Z.

config KB_LAYOUT_ENABLE_VI
    bool "Vietnamese (Telex input)"
    default y if DRAFTLING_LANG_PACK_VIETNAMESE
    help
        Enable Vietnamese typing with the Telex input method on a
        US-English keyboard (aa -> a-circumflex, dd -> d-stroke,
        s/f/r/x/j -> tone marks, z removes the tone). Also compiles in
        the Vietnamese letters (Latin Extended Additional) of the
        Greybeard / DejaVu Sans Mono fonts.

config KB_LAYOUT_ENABLE_KO
    bool "Korean (2-set Hangul)"
    default y if DRAFTLING_LANG_PACK_KOREAN
    help
        Enable the Korean Dubeolsik (2-set) layout. Jamo are composed
        into Hangul syllables as they are typed. Pulls in the CJK
        fonts.

config KB_LAYOUT_ENABLE_JA
    bool "Japanese (romaji, kana-kanji conversion)"
    default y if DRAFTLING_LANG_PACK_JAPANESE
    help
        Enable Japanese input: romaji typed on a US-English keyboard
        become hiragana, and Space converts the reading to kanji with
        a dictionary derived from the Mozc open-source dictionary
        (about 1 MB). Pulls in the CJK fonts.

config KB_LAYOUT_ENABLE_ZH
    bool "Chinese (pinyin)"
    default y if DRAFTLING_LANG_PACK_CHINESE
    help
        Enable Simplified Chinese input with full pinyin on a
        US-English keyboard, with a word dictionary derived from the
        Android Open Source Project PinyinIME (about 0.7 MB). Pulls
        in the CJK fonts.

config KB_LAYOUT_ENABLE_TA99
    bool "Tamil 99"
    default y if DRAFTLING_LANG_PACK_INDIC
    help
        Enable the Tamil 99 layout, the Government of Tamil Nadu
        standard (G.O. Ms. 17 of 1999): vowels on the left hand,
        consonants on the right; a vowel after a consonant joins it,
        the pulli is on F and is added automatically between doubled
        and nasal + stop consonants. Pulls in the Tamil fonts.

config KB_LAYOUT_ENABLE_TA_TW
    bool "Tamil Typewriter"
    default y if DRAFTLING_LANG_PACK_INDIC
    help
        Enable the Tamil Typewriter layout of the Tamil Nadu
        government typewriting examinations (the layout of eKalappai
        and Keyman's "Thamizha" typewriter keyboards): glyph-piece
        keys typed in visual order, e.g. the e / ee / ai sign before
        the consonant. Pulls in the Tamil fonts.

config KB_LAYOUT_ENABLE_TA_IN
    bool "Tamil InScript"
    default y if DRAFTLING_LANG_PACK_INDIC
    help
        Enable the Tamil InScript layout, the Government of India
        standard for Indian scripts (as in Windows "Tamil" and XKB
        "in(tam)"): vowel signs on the left hand, consonants on the
        right, independent vowels with Shift. Pulls in the Tamil
        fonts.

config KB_LAYOUT_ENABLE_TA_TV
    bool "Tamil Taravinyas"
    default y if DRAFTLING_LANG_PACK_INDIC
    help
        Enable the Taravinyas Tamil input engine
        (github.com/BandhanPramanik/tamil-input-engine-checkbox): a
        letter is picked by its place of articulation and its
        manner, with the home-row keys. Pulls in the Tamil fonts.

config DRAFTLING_HAS_TAMIL
    bool
    default y if KB_LAYOUT_ENABLE_TA99 || KB_LAYOUT_ENABLE_TA_TW || KB_LAYOUT_ENABLE_TA_IN || KB_LAYOUT_ENABLE_TA_TV

config KB_LAYOUT_ENABLE_HI_IN
    bool "Hindi InScript (Devanagari)"
    default y if DRAFTLING_LANG_PACK_INDIC
    help
        Enable the Devanagari InScript layout, the Government of India
        standard (Enhanced InScript, BIS 2016, as m17n "hi-inscript2"):
        vowel signs on the left hand (Shift: the vowels), consonants on
        the right, Devanagari digits on the number row and the conjuncts
        ksha, tra, jnya, shra on Shift + digits. Also types Sanskrit,
        Konkani, Maithili and the other Devanagari languages. Pulls in
        the Devanagari fonts and HarfBuzz.

config KB_LAYOUT_ENABLE_MR_IN
    bool "Marathi InScript (Devanagari)"
    default y if DRAFTLING_LANG_PACK_INDIC
    help
        Enable the Marathi Enhanced InScript layout (m17n
        "mr-inscript2"): Hindi InScript plus the Marathi letters
        (lla on Shift + N, eyelash ra on Shift + J, the candra signs).
        Pulls in the Devanagari fonts and HarfBuzz.

config KB_LAYOUT_ENABLE_NE_TR
    bool "Nepali Traditional (Devanagari)"
    default y if DRAFTLING_LANG_PACK_INDIC
    help
        Enable the Nepali Traditional layout (m17n "ne-trad"), the
        typewriter-derived layout used in Nepal. Pulls in the
        Devanagari fonts and HarfBuzz.

config KB_LAYOUT_ENABLE_NE_RO
    bool "Nepali Romanized (Devanagari)"
    default y if DRAFTLING_LANG_PACK_INDIC
    help
        Enable the Nepali Romanized layout (m17n "ne-rom"): Devanagari
        letters on the keys of their Latin sound (k = ka, s = sa).
        Pulls in the Devanagari fonts and HarfBuzz.

config DRAFTLING_HAS_DEVANAGARI
    bool
    default y if KB_LAYOUT_ENABLE_HI_IN || KB_LAYOUT_ENABLE_MR_IN || KB_LAYOUT_ENABLE_NE_TR || KB_LAYOUT_ENABLE_NE_RO

# Indic scripts need much more room above and below the letter body
# than Latin: with either, the fonts get taller lines (components/
# fonts, TALL_LINE_EXTRA).
config DRAFTLING_TALL_LINES
    bool
    default y if DRAFTLING_HAS_TAMIL || DRAFTLING_HAS_DEVANAGARI

# Latin Extended-A font subset (components/fonts/*_latina_NN.c): the
# letters of the Central / Eastern European, Baltic and Turkish
# languages and the spacing accents of their dead keys.
config DRAFTLING_HAS_LATIN_EXT_A
    bool
    default y if KB_LAYOUT_ENABLE_PL || KB_LAYOUT_ENABLE_CZ || KB_LAYOUT_ENABLE_SK || KB_LAYOUT_ENABLE_HU || KB_LAYOUT_ENABLE_RO || KB_LAYOUT_ENABLE_HR || KB_LAYOUT_ENABLE_TR

config DRAFTLING_HAS_CJK
    bool
    default y if KB_LAYOUT_ENABLE_KO || KB_LAYOUT_ENABLE_JA || KB_LAYOUT_ENABLE_ZH

# Which CJK font set is compiled in (components/fonts/cjk/<set>/): the
# glyph repertoire and regional glyph style of one language. With more
# than one CJK layout enabled by hand, the first of ja, zh, ko wins.
config DRAFTLING_CJK_FONT_SET
    string
    depends on DRAFTLING_HAS_CJK
    default "ja" if KB_LAYOUT_ENABLE_JA
    default "zh" if KB_LAYOUT_ENABLE_ZH
    default "ko"

endmenu
```
